## board/chainsx/avaota_f1/spi/kernel-fit.its
```
/dts-v1/;

/ {
	description = "Avaota F1 SPI boot FIT";
	#address-cells = <1>;

	images {
		kernel {
			description = "Linux kernel";
			data = /incbin/("Image.gz");
			type = "kernel";
			os = "linux";
			arch = "riscv";
			compression = "gzip";
			load = <0x80400000>;
			entry = <0x80400000>;
			hash-1 {
				algo = "crc32";
			};
		};

		ramdisk {
			description = "Buildroot initramfs";
			data = /incbin/("rootfs.cpio.gz");
			type = "ramdisk";
			os = "linux";
			arch = "riscv";
			compression = "gzip";
			load = <0x81800000>;
			entry = <0x81800000>;
			hash-1 {
				algo = "crc32";
			};
		};

		fdt {
			description = "Avaota F1 device tree";
			data = /incbin/("sun300i-v821-avaota-f1.dtb");
			type = "flat_dt";
			arch = "riscv";
			compression = "none";
			load = <0x80f80000>;
			hash-1 {
				algo = "crc32";
			};
		};
	};

	configurations {
		default = "conf-1";
		conf-1 {
			description = "Avaota F1 SPI boot configuration";
			kernel = "kernel";
			ramdisk = "ramdisk";
			fdt = "fdt";
		};
	};
};
```

## configs/avaota_f1_defconfig
```kconfig
BR2_riscv=y
BR2_riscv_g=y
BR2_RISCV_32=y
BR2_RISCV_ABI_ILP32D=y
BR2_PRIMARY_SITE="https://sources.buildroot.net"
BR2_TOOLCHAIN_BUILDROOT_MUSL=y
BR2_PACKAGE_HOST_LINUX_HEADERS_CUSTOM_7_0=y
BR2_KERNEL_HEADERS_AS_KERNEL=y
BR2_INIT_BUSYBOX=y
BR2_ROOTFS_DEVICE_CREATION_DYNAMIC_DEVTMPFS=y
BR2_TARGET_GENERIC_HOSTNAME="avaota"
BR2_TARGET_GENERIC_ISSUE="Avaota F1"
BR2_SYSTEM_DHCP=""
BR2_ROOTFS_POST_BUILD_SCRIPT="board/chainsx/avaota_f1/post-build.sh"
BR2_ROOTFS_POST_IMAGE_SCRIPT="board/chainsx/avaota_f1/post-image.sh"
BR2_ROOTFS_OVERLAY="board/chainsx/avaota_f1/rootfs-overlay"
BR2_PACKAGE_ALLWINNER_WIFIMANAGER=y
BR2_LINUX_KERNEL=y
BR2_LINUX_KERNEL_CUSTOM_GIT=y
BR2_LINUX_KERNEL_CUSTOM_REPO_URL="https://github.com/chainsx/linux-v821-mainline.git"
BR2_LINUX_KERNEL_CUSTOM_REPO_VERSION="4443fe60f2a84690dbe2c28dc99cddf25d0aaeac"
BR2_LINUX_KERNEL_USE_CUSTOM_CONFIG=y
BR2_LINUX_KERNEL_CUSTOM_CONFIG_FILE="board/chainsx/avaota_f1/linux.config"
BR2_LINUX_KERNEL_DTS_SUPPORT=y
BR2_LINUX_KERNEL_INTREE_DTS_NAME="allwinner/sun300i-v821-avaota-f1"
BR2_LINUX_KERNEL_NEEDS_HOST_OPENSSL=y
BR2_PACKAGE_LINUX_TOOLS_GPIO=y
BR2_TARGET_ROOTFS_EXT2=y
BR2_TARGET_ROOTFS_EXT2_4=y
BR2_TARGET_ROOTFS_CPIO=y
BR2_TARGET_ROOTFS_CPIO_GZIP=y
# BR2_TARGET_ROOTFS_TAR is not set
BR2_TARGET_OPENSBI=y
BR2_TARGET_OPENSBI_CUSTOM_GIT=y
BR2_TARGET_OPENSBI_CUSTOM_REPO_URL="https://github.com/chainsx/opensbi-v821-mainline.git"
BR2_TARGET_OPENSBI_CUSTOM_REPO_VERSION="0ff669444d8aa701ed7dbdb8bab9f50201833cdd"
BR2_TARGET_OPENSBI_PLAT="generic"
BR2_TARGET_OPENSBI_INSTALL_DYNAMIC_IMG=y
BR2_TARGET_UBOOT=y
BR2_TARGET_UBOOT_BUILD_SYSTEM_KCONFIG=y
BR2_TARGET_UBOOT_CUSTOM_GIT=y
BR2_TARGET_UBOOT_CUSTOM_REPO_URL="https://github.com/chainsx/u-boot-v821-mainline.git"
BR2_TARGET_UBOOT_CUSTOM_REPO_VERSION="bbab7b254728e53247449ac304dc68c4131aa6cc"
BR2_TARGET_UBOOT_BOARD_DEFCONFIG="avaota_f1_smode"
BR2_TARGET_UBOOT_NEEDS_DTC=y
BR2_TARGET_UBOOT_NEEDS_PYLIBFDT=y
BR2_TARGET_UBOOT_NEEDS_OPENSSL=y
BR2_TARGET_UBOOT_NEEDS_OPENSBI=y
BR2_TARGET_UBOOT_NEEDS_GNUTLS=y
# BR2_TARGET_UBOOT_FORMAT_BIN is not set
BR2_TARGET_UBOOT_FORMAT_CUSTOM=y
BR2_TARGET_UBOOT_FORMAT_CUSTOM_NAME="u-boot-sunxi-with-spl.bin"
BR2_PACKAGE_HOST_GENIMAGE=y
BR2_PACKAGE_HOST_UBOOT_TOOLS=y
BR2_PACKAGE_HOST_UBOOT_TOOLS_FIT_SUPPORT=y
BR2_PACKAGE_HOST_MTOOLS=y
BR2_PACKAGE_HOST_DOSFSTOOLS=y
```

## package/allwinner-wifimanager/Config.in
```kconfig
config BR2_PACKAGE_ALLWINNER_WIFIMANAGER
	bool "allwinner-wifimanager"
	depends on BR2_TOOLCHAIN_HAS_THREADS
	help
	  Minimal Allwinner wifimanager port using the V821 xrlink
	  backend. It provides the wifimg STA API and the wifi_sta test
	  utility; AP, P2P, and Linux nl80211 backends are not included.

comment "allwinner-wifimanager needs a toolchain w/ threads"
	depends on !BR2_TOOLCHAIN_HAS_THREADS
```
